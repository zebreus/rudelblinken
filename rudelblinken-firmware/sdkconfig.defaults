## rudelblinken-firmware/sdkconfig.defaults
```kconfig
# Rust often needs a bit of an extra main task stack size compared to C (the default is 3K)
CONFIG_ESP_MAIN_TASK_STACK_SIZE=20000
CONFIG_BT_NIMBLE_HOST_TASK_STACK_SIZE=20000
CONFIG_LWIP_IPV6=n
CONFIG_LWIP=n
# CONFIG_IPC_TASK_STACK_SIZE=1024
# CONFIG_TCPIP_TASK_STACK_SIZE=3072
# CONFIG_TIMER_TASK_STACK_SIZE=3584
# CONFIG_ESP_IPC_TASK_STACK_SIZE=1024
# CONFIG_PTHREAD_TASK_STACK_SIZE_DEFAULT=3072
# CONFIG_ESP_TIMER_TASK_STACK_SIZE=3584
# CONFIG_LWIP_TCPIP_TASK_STACK_SIZE=0
# CONFIG_SYSTEM_EVENT_TASK_STACK_SIZE=2304
# CONFIG_ESP32_PTHREAD_TASK_STACK_SIZE_DEFAULT=3072
# CONFIG_ESP_SYSTEM_EVENT_TASK_STACK_SIZE=2304
# CONFIG_FREERTOS_USE_TRACE_FACILITY=y
# CONFIG_FREERTOS_USE_STATS_FORMATTING_FUNCTIONS=y


# I tried to get us a bit more heap by disabling stuff. See https://md.darmstadt.ccc.de/optimizing-memory for a protocol on what I tried

# Move stuff from iram into flash so we have more memory
# See https://docs.espressif.com/projects/esp-idf/en/stable/esp32c3/api-guides/performance/ram-usage.html#optimizing-iram-usage
CONFIG_FREERTOS_PLACE_FUNCTIONS_INTO_FLASH=y
CONFIG_RINGBUF_PLACE_FUNCTIONS_INTO_FLASH=y
CONFIG_RINGBUF_PLACE_ISR_FUNCTIONS_INTO_FLASH=y
CONFIG_ESP_WIFI_IRAM_OPT=n
CONFIG_ESP_WIFI_RX_IRAM_OPT=n
CONFIG_SPI_FLASH_ROM_IMPL=y
CONFIG_SPI_FLASH_ROM_DRIVER_PATCH=n
CONFIG_ESP_EVENT_POST_FROM_IRAM_ISR=n
# Maybe enable this again:
CONFIG_SPI_MASTER_ISR_IN_IRAM=n
CONFIG_SPI_SLAVE_ISR_IN_IRAM=n
CONFIG_HAL_DEFAULT_ASSERTION_LEVEL=Disabled
CONFIG_UART_ISR_IN_IRAM=n

# Not sure if this breaks things:
CONFIG_SPI_FLASH_VENDOR_XMC_SUPPORTED=n
CONFIG_SPI_FLASH_VENDOR_GD_SUPPORTED=n
CONFIG_SPI_FLASH_VENDOR_ISSI_SUPPORTED=n
CONFIG_SPI_FLASH_VENDOR_MXIC_SUPPORTED=n
CONFIG_SPI_FLASH_VENDOR_WINBOND_SUPPORTED=n
CONFIG_SPI_FLASH_VENDOR_BOYA_SUPPORTED=n
CONFIG_SPI_FLASH_VENDOR_TH_SUPPORTED=n
CONFIG_SPI_FLASH_SUPPORT_ISSI_CHIP=n
CONFIG_SPI_FLASH_SUPPORT_MXIC_CHIP=n
CONFIG_SPI_FLASH_SUPPORT_GD_CHIP=n
CONFIG_SPI_FLASH_SUPPORT_WINBOND_CHIP=n
CONFIG_SPI_FLASH_SUPPORT_BOYA_CHIP=n
CONFIG_SPI_FLASH_SUPPORT_TH_CHIP=n

# Not sure if this does anything
CONFIG_SPI_FLASH_ENABLE_ENCRYPTED_READ_WRITE=n

# Really not sure if this is a good idea:
CONFIG_HEAP_PLACE_FUNCTION_INTO_FLASH=y

### Attempt to disable wifi stuff
CONFIG_ESP_WIFI_ENABLED=n
# CONFIG_ESP_WIFI_AMPDU_RX_ENABLED is not set
# CONFIG_ESP_WIFI_NVS_ENABLED is not set
# CONFIG_ESP_WIFI_SOFTAP_BEACON_MAX_LEN=752
# CONFIG_ESP_WIFI_MGMT_SBUF_NUM=6
# CONFIG_ESP_WIFI_IRAM_OPT is not set
# CONFIG_ESP_WIFI_EXTRA_IRAM_OPT is not set
# CONFIG_ESP_WIFI_RX_IRAM_OPT is not set
# CONFIG_ESP_WIFI_ENABLE_WPA3_SAE is not set
# CONFIG_ESP_WIFI_ENABLE_WPA3_OWE_STA is not set
# CONFIG_ESP_WIFI_SLP_IRAM_OPT is not set
# CONFIG_ESP_WIFI_SLP_DEFAULT_MIN_ACTIVE_TIME=50
# CONFIG_ESP_WIFI_SLP_DEFAULT_MAX_ACTIVE_TIME=10
# CONFIG_ESP_WIFI_SLP_DEFAULT_WAIT_BROADCAST_DATA_TIME=15
# CONFIG_ESP_WIFI_FTM_ENABLE is not set
# CONFIG_ESP_WIFI_STA_DISCONNECTED_PM_ENABLE=y
# CONFIG_ESP_WIFI_GCMP_SUPPORT is not set
# CONFIG_ESP_WIFI_GMAC_SUPPORT is not set
# CONFIG_ESP_WIFI_SOFTAP_SUPPORT is not set
# CONFIG_ESP_WIFI_SLP_BEACON_LOST_OPT is not set
# CONFIG_ESP_WIFI_ESPNOW_MAX_ENCRYPT_NUM=0
# CONFIG_ESP_WIFI_MBEDTLS_CRYPTO is not set

CONFIG_SW_COEXIST_ENABLE=n
CONFIG_ESP32_WIFI_SW_COEXIST_ENABLE=n
CONFIG_ESP_WIFI_SW_COEXIST_ENABLE=n


# Use this to set FreeRTOS kernel tick frequency to 1000 Hz (100 Hz by default).
# This allows to use 1 ms granularity for thread sleeps (10 ms by default).
CONFIG_FREERTOS_HZ=1000

# Workaround for https://github.com/espressif/esp-idf/issues/7631
#CONFIG_MBEDTLS_CERTIFICATE_BUNDLE=n
#CONFIG_MBEDTLS_CERTIFICATE_BUNDLE_DEFAULT_FULL=n
CONFIG_BT_ENABLED=y
CONFIG_BT_BLE_ENABLED=y
CONFIG_BT_BLUEDROID_ENABLED=n
CONFIG_BT_NIMBLE_ENABLED=y
CONFIG_BT_NIMBLE_EXT_ADV=n

CONFIG_BT_NIMBLE_L2CAP_COC_MAX_NUM=9

# CONFIG_BTDM_CTRL_MODE_BLE_ONLY=y
# CONFIG_BTDM_CTRL_MODE_BR_EDR_ONLY=n
# CONFIG_BTDM_CTRL_MODE_BTDM=n

# _BT_NIMBLE_ATT_PREFERRED_MTU=256
CONFIG_BT_NIMBLE_50_FEATURE_SUPPORT=y
CONFIG_BT_NIMBLE_LL_CFG_FEAT_LE_2M_PHY=y
CONFIG_BT_NIMBLE_LL_CFG_FEAT_LE_CODED_PHY=y
# SOC_BLE_MULTI_CONN_OPTIMIZATION=y
# BT_NIMBLE_OPTIMIZE_MULTI_CONN=y # Not supported on esp32-c3

# _CONFIG_BT_NIMBLE_SECURITY_ENABLE=n

# CONFIG_BT_NIMBLE_MEM_ALLOC_MODE_DEFAULT is not set
# CONFIG_BT_NIMBLE_LOG_LEVEL_NONE is not set
# CONFIG_BT_NIMBLE_LOG_LEVEL_ERROR is not set
CONFIG_BT_NIMBLE_LOG_LEVEL_WARNING=y
# CONFIG_BT_NIMBLE_LOG_LEVEL_INFO is not set
# CONFIG_BT_NIMBLE_LOG_LEVEL_DEBUG is not set
CONFIG_BT_NIMBLE_LOG_LEVEL=2
```
